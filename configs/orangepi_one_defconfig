## configs/orangepi_one_defconfig
```kconfig
CONFIG_ARM=y
CONFIG_ARCH_SUNXI=y
CONFIG_SYS_TEXT_BASE=0x4a000000
CONFIG_MACH_SUN8I_H3=y
CONFIG_DRAM_CLK=672
CONFIG_DRAM_ZQ=3881979
CONFIG_DRAM_ODT_EN=y
CONFIG_DEFAULT_DEVICE_TREE="sun8i-h3-orangepi-one"
# CONFIG_SYS_MALLOC_CLEAR_ON_INIT is not set
CONFIG_SPL=y
# CONFIG_CMD_FLASH is not set
# CONFIG_SPL_DOS_PARTITION is not set
# CONFIG_SPL_ISO_PARTITION is not set
# CONFIG_SPL_EFI_PARTITION is not set
CONFIG_USB_EHCI_HCD=y
CONFIG_SYS_USB_EVENT_POLL_VIA_INT_QUEUE=y
# CONFIG_SUN8I_EMAC is not set
# CONFIG_NET is not set
# CONFIG_DM_ETH is not set
# CONFIG_CMD_NET is not set
# CONFIG_CMD_DHCP is not set
# CONFIG_CMD_PXE is not set
# CONFIG_CMD_NFS is not set
# CONFIG_CMD_MII is not set
# CONFIG_CMD_PING is not set
# CONFIG_DISTRO_DEFAULTS is not set
CONFIG_CMD_BOOTZ=y
CONFIG_CMD_FAT=y
CONFIG_CMD_FS_GENERIC=y
CONFIG_CMD_PART=y
CONFIG_HUSH_PARSER=y
CONFIG_BOOTDELAY=1
CONFIG_ISO_PARTITION=y
```
